# file: ott-01.ioc
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Mcu.Family=STM32L4
RCC.MSI_VALUE=4000000
PA14\ (JTCK-SWCLK).Mode=Serial_Wire
FREERTOS.Queues01=Queue01,16,uint32_t,0,Dynamic,NULL,NULL
RCC.CortexFreq_Value=16000000
FREERTOS.Tasks01=Task01,24,128,StartTask01,Default,NULL,Dynamic,NULL,NULL;Task02,24,128,StartTask02,Default,NULL,Dynamic,NULL,NULL;SystemMonitorTa,8,128,StartSystemMonitorTask,Default,NULL,Dynamic,NULL,NULL
FREERTOS.BinarySemaphores01=BinarySem01,Dynamic,NULL
VP_SYS_VS_tim17.Mode=TIM17
PC15-OSC32_OUT\ (PC15).Signal=RCC_OSC32_OUT
PC15-OSC32_OUT\ (PC15).Mode=LSE-External-Oscillator
RCC.SYSCLKSource=RCC_SYSCLKSOURCE_HSI
ProjectManager.StackSize=0x400
PC14-OSC32_IN\ (PC14).Mode=LSE-External-Oscillator
VP_FREERTOS_VS_CMSIS_V2.Mode=CMSIS_V2
PA14\ (JTCK-SWCLK).Signal=SYS_JTCK-SWCLK
FREERTOS.configENABLE_FPU=1
ProjectManager.TargetToolchain=STM32CubeIDE
FREERTOS.configUSE_STATS_FORMATTING_FUNCTIONS=1
RCC.HCLKFreq_Value=16000000
RCC.APB2TimFreq_Value=16000000
RCC.AHBFreq_Value=16000000
RCC.HSE_VALUE=8000000
board=custom
RCC.VCOOutputFreq_Value=32000000
NVIC.TIM1_TRG_COM_TIM17_IRQn=true\:0\:0\:false\:false\:true\:false\:false\:true
RCC.APB2Freq_Value=16000000
Mcu.Name=STM32L476R(C-E-G)Tx
PA13\ (JTMS-SWDIO).Mode=Serial_Wire
RCC.SYSCLKFreq_VALUE=16000000
Mcu.Package=LQFP64
NVIC.TimeBase=TIM1_TRG_COM_TIM17_IRQn
PC14-OSC32_IN\ (PC14).Signal=RCC_OSC32_IN
NVIC.TimeBaseIP=TIM17
ProjectManager.HeapSize=0x200
FREERTOS.Timers01=Timer01,PeriodicTimerCb01,osTimerPeriodic,Default,NULL,Dynamic,NULL
RCC.HSI_VALUE=16000000
NVIC.PriorityGroup=NVIC_PRIORITYGROUP_4
RCC.APB1TimFreq_Value=16000000
PA13\ (JTMS-SWDIO).Signal=SYS_JTMS-SWDIO
RCC.APB1Freq_Value=16000000

// file: Core/Src/main.c
/* USER CODE BEGIN Header */
/**
  ******************************************************************************
  * @file           : main.c
  * @brief          : Main program body
  ******************************************************************************
  * @attention
  *
  * <h2><center>&copy; Copyright (c) 2021 STMicroelectronics.
  * All rights reserved.</center></h2>
  *
  * This software component is licensed by ST under BSD 3-Clause license,
  * the "License"; You may not use this file except in compliance with the
  * License. You may obtain a copy of the License at:
  *                        opensource.org/licenses/BSD-3-Clause
  *
  ******************************************************************************
  */
/* USER CODE END Header */
#include "main.h"
#include "cmsis_os.h"
#include "gpio.h"

/* USER CODE BEGIN Includes */
#include "util.h"
/* USER CODE END Includes */

void SystemClock_Config(void);
void MX_FREERTOS_Init(void);
/* USER CODE BEGIN PFP */
#if defined(DEBUG) && defined(USING_SEMIHOSTING)
extern void initialise_monitor_handles(void);
#endif
/* USER CODE END PFP */

int main(void)
{

  /* MCU Configuration--------------------------------------------------------*/

  /* Reset of all peripherals, Initializes the Flash interface and the Systick. */
  HAL_Init();

  /* Configure the system clock */
  SystemClock_Config();

  /* USER CODE BEGIN SysInit */
# if defined(USING_SEMIHOSTING)
  initialise_monitor_handles();
#endif
  /* USER CODE END SysInit */

  /* Initialize all configured peripherals */
  MX_GPIO_Init();
  /* USER CODE BEGIN 2 */
  DBG("Starting the FREERTOS\n");
  /* USER CODE END 2 */

  /* Init scheduler */
  osKernelInitialize();  /* Call init function for freertos objects (in freertos.c) */
  MX_FREERTOS_Init();
  /* Start scheduler */
  osKernelStart();

  /* We should never get here as control is now taken by the scheduler */
  /* Infinite loop */
  while (1)
  {

  }
}

void SystemClock_Config(void)
{
  RCC_OscInitTypeDef RCC_OscInitStruct = {0};
  RCC_ClkInitTypeDef RCC_ClkInitStruct = {0};

  /** Initializes the RCC Oscillators according to the specified parameters
  * in the RCC_OscInitTypeDef structure.
  */
  RCC_OscInitStruct.OscillatorType = RCC_OSCILLATORTYPE_HSI;
  RCC_OscInitStruct.HSIState = RCC_HSI_ON;
  RCC_OscInitStruct.HSICalibrationValue = RCC_HSICALIBRATION_DEFAULT;
  RCC_OscInitStruct.PLL.PLLState = RCC_PLL_NONE;
  if (HAL_RCC_OscConfig(&RCC_OscInitStruct) != HAL_OK)
  {
    Error_Handler();
  }
  /** Initializes the CPU, AHB and APB buses clocks
  */
  RCC_ClkInitStruct.ClockType = RCC_CLOCKTYPE_HCLK|RCC_CLOCKTYPE_SYSCLK
                              |RCC_CLOCKTYPE_PCLK1|RCC_CLOCKTYPE_PCLK2;
  RCC_ClkInitStruct.SYSCLKSource = RCC_SYSCLKSOURCE_HSI;
  RCC_ClkInitStruct.AHBCLKDivider = RCC_SYSCLK_DIV1;
  RCC_ClkInitStruct.APB1CLKDivider = RCC_HCLK_DIV1;
  RCC_ClkInitStruct.APB2CLKDivider = RCC_HCLK_DIV1;

  if (HAL_RCC_ClockConfig(&RCC_ClkInitStruct, FLASH_LATENCY_0) != HAL_OK)
  {
    Error_Handler();
  }
  /** Configure the main internal regulator output voltage
  */
  if (HAL_PWREx_ControlVoltageScaling(PWR_REGULATOR_VOLTAGE_SCALE1) != HAL_OK)
  {
    Error_Handler();
  }
}

 /**
  * @brief  Period elapsed callback in non blocking mode
  * @note   This function is called  when TIM17 interrupt took place, inside
  * HAL_TIM_IRQHandler(). It makes a direct call to HAL_IncTick() to increment
  * a global variable "uwTick" used as application time base.
  * @param  htim : TIM handle
  * @retval None
  */
void HAL_TIM_PeriodElapsedCallback(TIM_HandleTypeDef *htim)
{
  if (htim->Instance == TIM17) {
    HAL_IncTick();
  }
}

void Error_Handler(void)
{
  __disable_irq();
  while (1)
  {
  }
}

/************************ (C) COPYRIGHT STMicroelectronics *****END OF FILE****/

// file: Core/Src/freertos.c
/* USER CODE BEGIN Header */
/**
  ******************************************************************************
  * File Name          : freertos.c
  * Description        : Code for freertos applications
  ******************************************************************************
  * @attention
  *
  * <h2><center>&copy; Copyright (c) 2021 STMicroelectronics.
  * All rights reserved.</center></h2>
  *
  * This software component is licensed by ST under Ultimate Liberty license
  * SLA0044, the "License"; You may not use this file except in compliance with
  * the License. You may obtain a copy of the License at:
  *                             www.st.com/SLA0044
  *
  ******************************************************************************
  */
/* USER CODE END Header */

#include "FreeRTOS.h"
#include "task.h"
#include "main.h"
#include "cmsis_os.h"

/* USER CODE BEGIN Includes */
#include "util.h"
#include "queue.h"
/* USER CODE END Includes */

/* USER CODE BEGIN PTD */
typedef int (*cbFunc)(const char *__restrict, ...);
/* USER CODE END PTD */

/* USER CODE BEGIN PD */
#define SHOW_SYSTEM_INFO             (0U)
#define SOFTWARE_TIMER_PERIOD_MS     (5000U)
#define QUEUE_SEND_TIMEOUT_MS        (10U)
/* USER CODE END PD */

/* USER CODE BEGIN Variables */
#ifdef DEBUG
char pcWriteBuffer[512];
#endif

typedef struct {
    uint32_t counter;
    uint32_t queue_item;
    uint32_t last_tick_ts;
} data_t;

static data_t data;
/* USER CODE END Variables */
/* Definitions for Task01 */
osThreadId_t Task01Handle;
const osThreadAttr_t Task01_attributes = {
  .name = "Task01",
  .stack_size = 128 * 4,
  .priority = (osPriority_t) osPriorityNormal,
};
/* Definitions for Task02 */
osThreadId_t Task02Handle;
const osThreadAttr_t Task02_attributes = {
  .name = "Task02",
  .stack_size = 128 * 4,
  .priority = (osPriority_t) osPriorityNormal,
};
/* Definitions for SystemMonitorTa */
#if (SHOW_SYSTEM_INFO)
osThreadId_t SystemMonitorTaHandle;
const osThreadAttr_t SystemMonitorTa_attributes = {
  .name = "SystemMonitorTa",
  .stack_size = 128 * 4,
  .priority = (osPriority_t) osPriorityLow,
};
#endif
/* Definitions for Queue01 */
osMessageQueueId_t Queue01Handle;
const osMessageQueueAttr_t Queue01_attributes = {
  .name = "Queue01"
};
/* Definitions for Timer01 */
osTimerId_t Timer01Handle;
const osTimerAttr_t Timer01_attributes = {
  .name = "Timer01"
};
/* Definitions for BinarySem01 */
osSemaphoreId_t BinarySem01Handle;
const osSemaphoreAttr_t BinarySem01_attributes = {
  .name = "BinarySem01"
};

void StartTask01(void *argument);
void StartTask02(cbFunc cbLogs);
void StartSystemMonitorTask(void *argument);
void PeriodicTimerCb01(void *argument);

void MX_FREERTOS_Init(void); /* (MISRA C 2004 rule 8.1) */

void MX_FREERTOS_Init(void) {
  /* USER CODE BEGIN Init */
  cbFunc cbLogs = printf;
  /* USER CODE END Init */

  /* Create the semaphores(s) */
  /* creation of BinarySem01 */
  BinarySem01Handle = osSemaphoreNew(1, 1, &BinarySem01_attributes);

  /* Create the timer(s) */
  /* creation of Timer01 */
  Timer01Handle = osTimerNew(PeriodicTimerCb01, osTimerPeriodic, NULL, &Timer01_attributes);

  /* Create the queue(s) */
  /* creation of Queue01 */
  Queue01Handle = osMessageQueueNew (16, sizeof(uint32_t), &Queue01_attributes);

  /* Create the thread(s) */
  /* creation of Task01 */
  Task01Handle = osThreadNew(StartTask01, NULL, &Task01_attributes);

  /* creation of Task02 */
  Task02Handle = osThreadNew((osThreadFunc_t)StartTask02, cbLogs, &Task02_attributes);

  /* creation of SystemMonitorTa */
#if (SHOW_SYSTEM_INFO)
  SystemMonitorTaHandle = osThreadNew(StartSystemMonitorTask, NULL, &SystemMonitorTa_attributes);
#endif

}

void StartTask01(void *argument)
{
  /* USER CODE BEGIN StartTask01 */
  osTimerStart(Timer01Handle, SOFTWARE_TIMER_PERIOD_MS);
  osSemaphoreAcquire(BinarySem01Handle, osWaitForever);
  data.last_tick_ts = uwTick;
  /* Infinite loop */
  for(;;)
  {
    osSemaphoreAcquire(BinarySem01Handle, osWaitForever);
    data.counter++;
    xQueueSendToBack(Queue01Handle, &data.counter, QUEUE_SEND_TIMEOUT_MS);
    osDelay(1);
  }
  /* USER CODE END StartTask01 */
}

void StartTask02(cbFunc cbLogs)
{
  /* USER CODE BEGIN StartTask02 */
  /* Infinite loop */
  for(;;)
  {
    if (xQueueReceive(Queue01Handle, &data.queue_item, 0) == pdTRUE) {
        cbLogs("The Element in the queue is %d, time has been passed %d ms\n",
        (unsigned int)data.queue_item, (unsigned int)UW_TICK_DIFF(data.last_tick_ts, uwTick));

      data.last_tick_ts = uwTick;
    }
    osDelay(1);
  }
  /* USER CODE END StartTask02 */
}

#if (SHOW_SYSTEM_INFO)
void StartSystemMonitorTask(void *argument)
{
  /* USER CODE BEGIN StartSystemMonitorTask */
  /* Infinite loop */
  for(;;)
  {
#ifdef DEBUG
    osDelay(2000);
    vTaskList(pcWriteBuffer);
    DBG("%s\n", pcWriteBuffer);
#endif
    osDelay(1);
  }
  /* USER CODE END StartSystemMonitorTask */
}
#endif

/* PeriodicTimerCb01 function */
void PeriodicTimerCb01(void *argument)
{
  /* USER CODE BEGIN PeriodicTimerCb01 */
  osSemaphoreRelease(BinarySem01Handle);
  /* USER CODE END PeriodicTimerCb01 */
}

/************************ (C) COPYRIGHT STMicroelectronics *****END OF FILE****/
